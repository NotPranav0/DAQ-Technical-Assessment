VERSION "TestDBC2"
NS_ :

BS_:
BU_: ECU

BO_ 256 TestMessage: 8 ECU
 SG_ Temp : 0|16@1+ (1,0) [0|100] "C" ECU
